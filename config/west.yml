## config/west.yml
```yaml
manifest:
  remotes:
    - name: zmkfirmware
      url-base: https://github.com/zmkfirmware
    - name: caksoylar
      url-base: https://github.com/caksoylar
    - name: grassfedreeve
      url-base: https://github.com/grassfedreeve
    - name: ssbb
      url-base: https://github.com/ssbb
  projects:
    - name: zmk
      remote: zmkfirmware
      revision: v0.3
      import: app/west.yml
    - name: zmk-rgbled-widget
      remote: caksoylar
      revision: v0.3
    - name: zmk-keyboards-akohekohe
      remote: grassfedreeve
      revision: v0.3
    - name: zmk-antecedent-morph
      remote: ssbb
      revision: v0.3
  self:
    path: config
```
